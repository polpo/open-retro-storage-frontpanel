## sw-frontpanel/main/Kconfig.projbuild
```kconfig
menu "Product Configuration"

    choice PRODUCT_TYPE
        prompt "Product type"
        default PRODUCT_PICOIDE
        help
            Select the product type for branding and feature configuration.

        config PRODUCT_PICOIDE
            bool "PicoIDE"
            help
                Build for PicoIDE product.

        config PRODUCT_BLUESCSI
            bool "BlueSCSI"
            help
                Build for BlueSCSI product.
    endchoice

    choice PANEL_BOARD
        prompt "Panel board"
        default PANEL_BOARD_FRONTPANEL
        help
            Which physical board the firmware runs on. This selects the pin
            map in gpio_pins.h.

        config PANEL_BOARD_FRONTPANEL
            bool "Open Retro Storage front panel PCB"
            help
                The shipping panel: ESPC3-12 module, SH1107 OLED, four
                navigation buttons, WS2812 LED.

        config PANEL_BOARD_C3_SUPERMINI
            bool "ESP32-C3 SuperMini (DIY, web UI only)"
            depends on PRODUCT_BLUESCSI
            select PANEL_NO_DISPLAY
            help
                A bare ESP32-C3 SuperMini wired to a BlueSCSI v2 with two
                signal wires, for the web interface without a display or
                buttons. That board only breaks out GPIO0-10, 20 and 21
                (GPIO18/19 are its USB-C data pins), so the shipping pin map
                does not fit and the host link has to be I2C.

                Wiring: C3 GPIO3 -> Pico GPIO16 (SDA), C3 GPIO10 ->
                Pico GPIO17 (SCL), GND -> GND, plus 2.2k pull-ups from each
                signal to 3V3. The link runs at 1 MHz and the panel PCB
                normally supplies those pull-ups.
    endchoice

    config PANEL_NO_DISPLAY
        bool
        default n
        help
            Build without the SH1107 OLED. u8g2 still renders into its RAM
            frame buffer (so the web UI and the test hooks work unchanged),
            but nothing is clocked out and no SPI bus is claimed.

    config MAX_DEVICES
        int
        default 8 if PRODUCT_BLUESCSI
        default 2 if PRODUCT_PICOIDE

    choice HOST_TRANSPORT
        prompt "Host communication transport"
        default HOST_TRANSPORT_I2C if PANEL_BOARD_C3_SUPERMINI
        default HOST_TRANSPORT_AUTO if PRODUCT_BLUESCSI
        default HOST_TRANSPORT_SPI
        help
            Physical link used to talk to the host main board. BlueSCSI
            auto-detects it at boot (v2 uses I2C, Ultra/Ultra Wide use SPI)
            and persists the last transport a live main board answered on in
            NVS; PicoIDE always uses SPI. The forced SPI/I2C options exist for
            debugging a single transport.

        config HOST_TRANSPORT_AUTO
            bool "Auto-detect (SPI or I2C)"
            depends on PRODUCT_BLUESCSI && !PANEL_BOARD_C3_SUPERMINI
            help
                Probe for the main board on both transports at boot and
                remember the one that answered, so one BlueSCSI binary covers
                v2 (I2C) and Ultra/Ultra Wide (SPI).

        config HOST_TRANSPORT_SPI
            bool "SPI (forced)"
            depends on !PANEL_BOARD_C3_SUPERMINI
            help
                10 MHz SPI master (BlueSCSI Ultra/Ultra Wide, PicoIDE).

        config HOST_TRANSPORT_I2C
            bool "I2C (forced)"
            help
                1 MHz I2C master (BlueSCSI v2).
    endchoice

    config PANEL_TEST_HOOKS
        bool "Enable panel test hooks"
        default n
        help
            Adds /api/button, /api/ui and /api/screen so a bench harness can
            press buttons and read back the screen, menu cursor and framebuffer.
            Off in shipping builds: it is a remote control surface for the UI.

endmenu
```
